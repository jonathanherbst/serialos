## platforms/beagleboneblack/meta-megaserial/conf/machine/beagle-megaserial.conf
```bitbake
#@TYPE: Machine
#@NAME: BeagleBone machine
#@DESCRIPTION: Machine configuration for the http://beagleboard.org/bone board

DEFAULTTUNE ?= "cortexa8hf-neon"
include conf/machine/include/arm/armv7a/tune-cortexa8.inc

MACHINE_EXTRA_RRECOMMENDS = "kernel-modules"

PREFERRED_PROVIDER_virtual/kernel = "linux-megaserial"
PREFERRED_VERSION_linux-bb.org = "6.6%"

DT_VENDOR_PREFIX = "ti/omap/"

IMAGE_FSTYPES = "tar.xz wic.xz wic.bmap"
WKS_FILES = "sdimage-2part.wks"
MACHINE_ESSENTIAL_EXTRA_RDEPENDS += "kernel-image kernel-devicetree"
do_image_wic[depends] += "mtools-native:do_populate_sysroot dosfstools-native:do_populate_sysroot virtual/bootloader:do_deploy"

KERNEL_IMAGETYPE = "zImage"
DTB_FILES = "am335x-boneblack.dtb"
KERNEL_DEVICETREE = '${@' '.join('ti/omap/%s' % d for d in '${DTB_FILES}'.split())}'
DEVICETREE_FILE = "${@(d.getVar('KERNEL_DEVICETREE') or "").replace("ti/omap/","")}"

EXTRA_IMAGEDEPENDS += "megaserial-bbb-overlay"

PREFERRED_PROVIDER_virtual/bootloader ?= "u-boot"

SPL_BINARY = "MLO"
UBOOT_SUFFIX = "img"
UBOOT_MACHINE = "am335x_evm_defconfig"

UBOOT_ENTRYPOINT = "0x80008000"
UBOOT_LOADADDRESS = "0x80008000"

# Generate an extlinux.conf file
UBOOT_EXTLINUX = "1"
UBOOT_EXTLINUX_ROOT = "root=PARTUUID=${uuid}"
UBOOT_EXTLINUX_KERNEL_ARGS = "rootwait rw earlycon"
UBOOT_EXTLINUX_BOOT_FILES = " \
    extlinux.conf;extlinux/extlinux.conf \
    ${KERNEL_IMAGETYPE} \
    ${DEVICETREE_FILE} \
"

MACHINE_FEATURES = "usbgadget usbhost vfat alsa"

IMAGE_BOOT_FILES ?= "\
    extlinux.conf;extlinux/extlinux.conf \
    u-boot.${UBOOT_SUFFIX}\
    ${SPL_BINARY}\
    ${KERNEL_IMAGETYPE}\
    ${DTB_FILES}\
    devicetree/megaserial-bbb.dtbo\
"

UBOOT_EXTLINUX_FDTOVERLAYS = "${UBOOT_EXTLINUX_FDTDIR}devicetree/megaserial-bbb.dtbo"

SERIAL_CONSOLES = "115200;ttyS0"
```

## yocto/meta-serialos/common/conf/distro/serialos.conf
```bitbake
DISTRO = "serialos"
DISTRO_NAME = "SerialOS (Distro for serialos devices)"
DISTRO_VERSION = "0.1.0"

SDK_VENDOR = "-serialossdk"
SDK_VERSION = "${@d.getVar('DISTRO_VERSION').replace('snapshot-${METADATA_REVISION}', 'snapshot')}"
SDK_VERSION[vardepvalue] = "${SDK_VERSION}"

MAINTAINER = "Jonathan Herbst <amd64d@gmail.com>"

TARGET_VENDOR = "-serialos"

LOCALCONF_VERSION = "2"

SDK_NAME = "${DISTRO}-${TCLIBC}-${SDKMACHINE}-${IMAGE_BASENAME}-${TUNE_PKGARCH}-${MACHINE}"
SDKPATHINSTALL = "/opt/${DISTRO}/${SDK_VERSION}"

DISTRO_EXTRA_RDEPENDS = "packagegroup-core-boot"
DISTRO_EXTRA_RRECOMMENDS = "kernel-module-af-packet"
DISTRO_FEATURES = "systemd"

PACKAGE_CLASSES ?= "package_rpm"

SANITY_TESTED_DISTROS ?= " \
    ubuntu-24.04 \n \
    "
# add poky sanity bbclass
INHERIT += "poky-sanity"

require conf/distro/include/poky-world-exclude.inc

BB_SIGNATURE_HANDLER ?= "OEEquivHash"
BB_HASHSERVE ??= "auto"

INIT_MANAGER = "systemd"

# We need debug symbols so that SPDX license manifests for the kernel work
KERNEL_EXTRA_FEATURES:append = " features/debug/debug-kernel.scc"
```

## yocto/meta-serialos/conf/distro/serialos.conf
```bitbake
DISTRO = "serialos"
DISTRO_NAME = "SerialOS (Distro for serialos devices)"
DISTRO_VERSION = "0.1.0"

SDK_VENDOR = "-serialossdk"
SDK_VERSION = "${@d.getVar('DISTRO_VERSION').replace('snapshot-${METADATA_REVISION}', 'snapshot')}"
SDK_VERSION[vardepvalue] = "${SDK_VERSION}"

MAINTAINER = "Jonathan Herbst <amd64d@gmail.com>"

TARGET_VENDOR = "-serialos"

LOCALCONF_VERSION = "2"

DISTRO_FEATURES = "${DISTRO_FEATURES_DEFAULT}"

PREFERRED_VERSION_linux-yocto ?= "6.6%"
PREFERRED_VERSION_linux-yocto-rt ?= "6.6%"

SDK_NAME = "${DISTRO}-${TCLIBC}-${SDKMACHINE}-${IMAGE_BASENAME}-${TUNE_PKGARCH}-${MACHINE}"
SDKPATHINSTALL = "/opt/${DISTRO}/${SDK_VERSION}"

DISTRO_EXTRA_RDEPENDS = "packagegroup-core-boot"
DISTRO_EXTRA_RRECOMMENDS = "kernel-module-af-packet"

TCLIBCAPPEND = ""

PACKAGE_CLASSES ?= "package_rpm"

SANITY_TESTED_DISTROS ?= " \
            debian-12 \n \
            "
# add poky sanity bbclass
INHERIT += "poky-sanity"

# QA check settings - a little stricter than the OE-Core defaults
# (none currently necessary as we now match OE-Core)
#WARN_TO_ERROR_QA = "X"
#WARN_QA_remove = "${WARN_TO_ERROR_QA}"
#ERROR_QA_append = " ${WARN_TO_ERROR_QA}"

require conf/distro/include/poky-world-exclude.inc
require conf/distro/include/no-static-libs.inc
require conf/distro/include/yocto-uninative.inc
require conf/distro/include/security_flags.inc
INHERIT += "uninative"

BB_SIGNATURE_HANDLER ?= "OEEquivHash"
BB_HASHSERVE ??= "auto"

INIT_MANAGER = "mdev-busybox"

# We need debug symbols so that SPDX license manifests for the kernel work
KERNEL_EXTRA_FEATURES:append = " features/debug/debug-kernel.scc"

# Enable creation of SPDX manifests by default
INHERIT += "create-spdx"
```

## yocto/meta-serialos/conf/machine/raspberrypi0-2w-64-serialos.conf
```bitbake
include conf/machine/raspberrypi0-2w-64.conf

WKS_FILE = "sdimage-raspberrypi-serialos.wks"
```
